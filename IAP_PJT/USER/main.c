#include <string.h>
#include "stm32f10x.h"
#include "delay.h"
#include "sys.h"
#include "usart.h"
#include "led.h"
#include "core_cm3.h"
#include "common.h"
#include "config.h"
#include "lcd.h"


/************************************************
 ALIENTEK 战舰STM32F103开发板实验0
 工程模板
 注意，这是手册中的新建工程章节使用的main文件 
 技术支持：www.openedv.com
 淘宝店铺：http://eboard.taobao.com 
 关注微信公众平台微信号："正点原子"，免费获取STM32资料。
 广州市星翼电子科技有限公司  
 作者：正点原子 @ALIENTEK
************************************************/



#if FLASH_DOWNLOAD
typedef  void (*pFunction)(void);

pFunction Jump_To_Application;
uint32_t JumpAddress;

uint8_t WriteBuf_1024[] =
{
	0x48, 0x07, 0x00, 0x20, 0xCD, 0x01, 0x02, 0x08, 0xE9, 0x03, 0x02, 0x08, 0x95, 0x03, 0x02, 0x08, 0xE5, 0x03, 0x02, 0x08, 0x75, 0x02, 0x02, 0x08, 0x6B, 0x06, 0x02, 0x08, 0x00, 0x00, 0x00, 0x00,
	0x00, 0x00, 0x00, 0x00, 0x00, 0x00, 0x00, 0x00, 0x00, 0x00, 0x00, 0x00, 0x0D, 0x04, 0x02, 0x08, 0x79, 0x02, 0x02, 0x08, 0x00, 0x00, 0x00, 0x00, 0xEB, 0x03, 0x02, 0x08, 0x21, 0x05, 0x02, 0x08,
	0xE7, 0x01, 0x02, 0x08, 0xE7, 0x01, 0x02, 0x08, 0xE7, 0x01, 0x02, 0x08, 0xE7, 0x01, 0x02, 0x08, 0xE7, 0x01, 0x02, 0x08, 0xE7, 0x01, 0x02, 0x08, 0xE7, 0x01, 0x02, 0x08, 0xE7, 0x01, 0x02, 0x08,
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	0x00, 0x00, 0x00, 0x00};

#endif

 void Delay(u32 count)
 {
   u32 i=0;
   for(;i<count;i++);
 }
 
 

int main(void)
{	
	int count = 0;
	int Ret = DRV_FAILED;
	int TimePeriod = 500; /* 默认500毫秒闪烁一下 */
	
	delay_init();	    //延时函数初始化
	LED_Init();		  	//初始化与LED连接的硬件接口
	uart_init(115200);	 	//串口uart1, 波特率115200
	LCD_Init();
	POINT_COLOR=BLACK;
	LCD_Clear(WHITE);

#if DEBUG_LCD
	bDisplayUpdate = 0;
#endif

#if FLASH_DOWNLOAD
	FLASH_Unlock();
	FlashProtectCheck();

	/* 禁用FLASH写保护 */
	if(BOOL_TRUE == FlashProtection)
	{
		/* Disable the write protection of desired pages */
    	Ret = FLASH_DisableWriteProtectionPages();
		if(DRV_SUCCESS != Ret)
		{
			/* 不管写入程序是否成功, 都要往下执行。区别是LED灯闪烁间隔不同 */
			TimePeriod = 1000;
		}
	}

	Ret = FlashDownload(&WriteBuf_1024[0], sizeof(WriteBuf_1024));
	if(DRV_SUCCESS != Ret)
	{
		/* 不管写入程序是否成功, 都要往下执行。区别是LED灯闪烁间隔不同 */
		TimePeriod = 200;
	}
#endif

	  

	while(1)
	{
	
	#if DEBUG_LCD
      	if(0 != bDisplayUpdate)
		{
			LED1=!LED1;	
			LCD_ShowString(30,40,210,24,24, &USART_RX_BUF[0]);
			
			#if DEBUG_UART
			printf("Receive:[%s]\r\n", &USART_RX_BUF[0]);
			#endif
			
			memset(&USART_RX_BUF[0], 0, (USART_RX_STA&0x3FFF));
			USART_RX_STA = 0;
			bDisplayUpdate = 0;
		}
	#endif
		LED0=!LED0;				   		 
		delay_ms(1000);	
	}
#if 0 /* 主线代码临时屏蔽 2026-06-06 */
	/********************************************************* 
	 * 失败逻辑如下：
	 * 不管FLASH写保护检测、擦除、写入是否失败, 程序都往下执行到while循环中，一个LED灯一直闪烁
	 * 但是闪烁间隔不同：
	 * 如果是正常执行, 闪烁间隔为500毫秒, 同时跳转后, 变成两个LED灯交替闪烁
	 * 如果是判断FLASH是否写保护失败, 则一个LED灯闪烁,闪烁间隔1000毫秒
	 * 如果是FLASH擦除或写入失败，则是一个LED灯闪烁, 闪烁间隔200毫秒
	**********************************************************/
	while(1)
	{
			LED0=0;
			//LED1=1;
			delay_ms(TimePeriod);
			LED0=1;
			//LED1=0;
			delay_ms(TimePeriod);
		
			/* 只有写入成功了, 才定时跳转到APP程序, 如果失败了, 就一直闪烁 */
			if(500 == TimePeriod)
			{
				count++;
			}

#if FLASH_DOWNLOAD
			if(count == 10)
			{
					JumpAddress = *(__IO uint32_t*) (ApplicationAddress + 4);

					/* Jump to user application */
					Jump_To_Application = (pFunction) JumpAddress;
					/* Initialize user application's Stack Pointer */
					__set_MSP(*(__IO uint32_t*) ApplicationAddress);
					Jump_To_Application();
			}
#endif
	}

#endif /* 主线代码临时屏蔽 2026-06-06 */
}

 
